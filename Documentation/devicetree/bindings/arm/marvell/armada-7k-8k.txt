## Documentation/devicetree/bindings/arm/marvell/armada-7k-8k.txt
```
Marvell Armada 7K/8K Platforms Device Tree Bindings
---------------------------------------------------

Boards using a SoC of the Marvell Armada 7K/8K or CN913x families must carry
the following root node property:

 - compatible, with one of the following values:

   - "marvell,armada7020", "marvell,armada-ap806-dual", "marvell,armada-ap806"
      when the SoC being used is the Armada 7020

   - "marvell,armada7040", "marvell,armada-ap806-quad", "marvell,armada-ap806"
      when the SoC being used is the Armada 7040

   - "marvell,armada8020", "marvell,armada-ap806-dual", "marvell,armada-ap806"
      when the SoC being used is the Armada 8020

   - "marvell,armada8040", "marvell,armada-ap806-quad", "marvell,armada-ap806"
      when the SoC being used is the Armada 8040

   - "marvell,cn9130", "marvell,armada-ap807-quad", "marvell,armada-ap807"
      when the SoC being used is the Armada CN9130 with no external CP.

   - "marvell,cn9131", "marvell,cn9130",
     "marvell,armada-ap807-quad", "marvell,armada-ap807"
      when the SoC being used is the Armada CN9130 with one external CP.

   - "marvell,cn9132", "marvell,cn9131", "marvell,cn9130",
     "marvell,armada-ap807-quad", "marvell,armada-ap807"
      when the SoC being used is the Armada CN9130 with two external CPs.

Example:

compatible = "marvell,armada7040-db", "marvell,armada7040",
             "marvell,armada-ap806-quad", "marvell,armada-ap806";
```

## Documentation/devicetree/bindings/i3c/i3c.yaml
```yaml
# SPDX-License-Identifier: (GPL-2.0-only OR BSD-2-Clause)
%YAML 1.2
---
$id: http://devicetree.org/schemas/i3c/i3c.yaml#
$schema: http://devicetree.org/meta-schemas/core.yaml#

title: I3C bus binding

maintainers:
  - Alexandre Belloni <alexandre.belloni@bootlin.com>
  - Miquel Raynal <miquel.raynal@bootlin.com>

description: |
  I3C busses can be described with a node for the primary I3C controller device
  and a set of child nodes for each I2C or I3C slave on the bus. Each of them
  may, during the life of the bus, request mastership.

properties:
  $nodename:
    pattern: "^i3c-master@[0-9a-f]+$"

  "#address-cells":
    const: 3
    description: |
      Each I2C device connected to the bus should be described in a subnode.

      All I3C devices are supposed to support DAA (Dynamic Address Assignment),
      and are thus discoverable. So, by default, I3C devices do not have to be
      described in the device tree. This being said, one might want to attach
      extra resources to these devices, and those resources may have to be
      described in the device tree, which in turn means we have to describe
      I3C devices.

      Another use case for describing an I3C device in the device tree is when
      this I3C device has a static I2C address and we want to assign it a
      specific I3C dynamic address before the DAA takes place (so that other
      devices on the bus can't take this dynamic address).

  "#size-cells":
    const: 0

  i3c-scl-hz:
    description: |
      Frequency of the SCL signal used for I3C transfers. When undefined, the
      default value should be 12.5MHz.

      May not be supported by all controllers.

  i2c-scl-hz:
    description: |
      Frequency of the SCL signal used for I2C transfers. When undefined, the
      default should be to look at LVR (Legacy Virtual Register) values of
      I2C devices described in the device tree to determine the maximum I2C
      frequency.

      May not be supported by all controllers.

required:
  - "#address-cells"
  - "#size-cells"

patternProperties:
  "^.*@[0-9a-f]+$":
    type: object
    description: |
      I2C child, should be named: <device-type>@<i2c-address>

      All properties described in Documentation/devicetree/bindings/i2c/i2c.txt
      are valid here, except the reg property whose content is changed.

    properties:
      compatible:
        description:
          Compatible of the I2C device.

      reg:
        items:
          - items:
              - description: first cell (tbd)
              - description: second cell (tbd)
              - description: third cell (tbd)

    required:
      - compatible
      - reg

  "^.*@[0-9a-f]+,[0-9a-f]+$":
    type: object
    description: |
      I3C child, should be named: <device-type>@<static-i2c-address>,<i3c-pid>

    properties:
      reg:
        items:
          - items:
              - description: first cell (tbd)
              - description: second cell (tbd)
              - description: third cell (tbd)

      assigned-address:
        $ref: /schemas/types.yaml#/definitions/uint32
        minimum: 0x01
        maximum: 0xFF
        description: |
          Dynamic address to be assigned to this device. This property is only
          valid if the I3C device has a static address (first cell of the reg
          property != 0).

    required:
      - reg

additionalProperties: true

examples:
  - |
    i3c-master@d040000 {
        compatible = "cdns,i3c-master";
        clocks = <&coreclock>, <&i3csysclock>;
        clock-names = "pclk", "sysclk";
        interrupts = <3 0>;
        reg = <0x0d040000 0x1000>;
        #address-cells = <3>;
        #size-cells = <0>;
        i2c-scl-hz = <100000>;

        /* I2C device. */
        nunchuk: nunchuk@52 {
            compatible = "nintendo,nunchuk";
            reg = <0x52 0x0 0x10>;
        };

        /* I3C device with a static I2C address. */
        thermal_sensor: sensor@68,39200144004 {
            reg = <0x68 0x392 0x144004>;
            assigned-address = <0xa>;
        };

        /*
         * I3C device without a static I2C address but requiring
         * resources described in the DT.
         */
        sensor@0,39200154004 {
            reg = <0x0 0x392 0x154004>;
            clocks = <&clock_provider 0>;
        };
    };
```

## Documentation/devicetree/bindings/interrupt-controller/marvell,sei.txt
```
Marvell SEI (System Error Interrupt) Controller
-----------------------------------------------

Marvell SEI (System Error Interrupt) controller is an interrupt
aggregator. It receives interrupts from several sources and aggregates
them to a single interrupt line (an SPI) on the parent interrupt
controller.

This interrupt controller can handle up to 64 SEIs, a set comes from the
AP and is wired while a second set comes from the CPs by the mean of
MSIs. Each 'domain' is represented as a subnode.

Required properties:

- compatible: should be "marvell,armada-8k-sei".
- reg: SEI registers location and length.
- interrupts: identifies the parent IRQ that will be triggered.
- marvell,sei-ranges: two ranges, the first one describe wired
                      interrupts coming from the AP, the second one
                      non-wired interrupts (MSI) from the CPs.
- #interrupt-cells: number of cells to define an SEI wired interrupt
                    coming from the AP, should be 1. The cell is the IRQ
                    number.
- interrupt-controller: identifies the node as an interrupt controller
                        (AP only).
- msi-controller: identifies the node as an MSI controller (CPs only).

Example:

        sei: interrupt-controller@3f0200 {
                compatible = "marvell,armada-8k-sei";
                reg = <0x3f0200 0x40>;
                interrupts = <GIC_SPI 0 IRQ_TYPE_LEVEL_HIGH>;
                marvell,sei-ap-ranges = <0 21>;
                marvell,sei-cp-ranges = <21 43>;
                #interrupt-cells = <1>;
                interrupt-controller;
                msi-controller;
        };
```

## Documentation/devicetree/bindings/mtd/marvell-nand.txt
```
Marvell NAND Flash Controller (NFC)

Required properties:
- compatible: can be one of the following:
    * "marvell,armada-8k-nand-controller"
    * "marvell,armada370-nand-controller"
    * "marvell,pxa3xx-nand-controller"
    * "marvell,armada-8k-nand" (deprecated)
    * "marvell,armada370-nand" (deprecated)
    * "marvell,pxa3xx-nand" (deprecated)
- reg: NAND flash controller memory area.
- #address-cells: shall be set to 1. Encode the NAND CS.
- #size-cells: shall be set to 0.
- interrupts: shall define the NAND controller interrupt.
- clocks: shall reference the NAND controller clock.
- marvell,system-controller: Set to retrieve the syscon node that handles
  NAND controller related registers (only required with the
  "marvell,armada-8k-nand[-controller]" compatibles).

Optional properties:
- label: see partition.txt. New platforms shall omit this property.
- dmas: shall reference DMA channel associated to the NAND controller.
- dma-names: shall be "rxtx".

Optional children nodes:
Children nodes represent the available NAND chips.

Required properties:
- reg: shall contain the native Chip Select ids (0-3)
- marvell,rb: shall contain the native Ready/Busy ids (0-1)

Optional properties:
- marvell,nand-keep-config: orders the driver not to take the timings
  from the core and leaving them completely untouched. Bootloader
  timings will then be used.
- nand-on-flash-bbt: see nand.txt.
- nand-ecc-mode: see nand.txt. Will use hardware ECC if not specified.
- nand-ecc-algo: see nand.txt. This property may be added when using
  hardware ECC for clarification but will be ignored by the driver
  because ECC mode is chosen depending on the page size and the strength
  required by the NAND chip. This value may be overwritten with
  nand-ecc-strength property.
- nand-ecc-strength: see nand.txt.
- nand-ecc-step-size: see nand.txt. This has no effect and will be
  ignored by the driver when using hardware ECC because Marvell's NAND
  flash controller does use fixed strength (1-bit for Hamming, 16-bit
  for BCH), so the step size will shrink or grow in order to fit the
  required strength. Step sizes are not completely random for all and
  follow certain patterns described in AN-379, "Marvell SoC NFC ECC".

See Documentation/devicetree/bindings/mtd/nand.txt for more details on
generic bindings.


Example:
nand_controller: nand-controller@d0000 {
	compatible = "marvell,armada370-nand-controller";
	reg = <0xd0000 0x54>;
	#address-cells = <1>;
	#size-cells = <0>;
	interrupts = <GIC_SPI 84 IRQ_TYPE_LEVEL_HIGH>;
	clocks = <&coredivclk 0>;

	nand@0 {
		reg = <0>;
		marvell,rb = <0>;
		nand-ecc-mode = "hw";
		marvell,nand-keep-config;
		nand-on-flash-bbt;
		nand-ecc-strength = <4>;
		nand-ecc-step-size = <512>;

		partitions {
			compatible = "fixed-partitions";
			#address-cells = <1>;
			#size-cells = <1>;

			partition@0 {
				label = "Rootfs";
				reg = <0x00000000 0x40000000>;
			};
		};
	};
};
```

## Documentation/devicetree/bindings/serial/mvebu-uart.txt
```
* Marvell UART : Non standard UART used in some of Marvell EBU SoCs
                 e.g., Armada-3700.

Required properties:
- compatible: "marvell,armada-3700-uart" for the first UART port or
              "marvell,armada-3700-uart-ext" for the second UART port
	      which has an extended IP and also some registers/bitfields
	      moved. Using a different compatible for this second port
	      allows to automatically select the right offsets.
- reg: offset and length of the register set for the device.
- clocks: UART reference clock used to derive the baudrate.
- interrupts: device interrupts. Each port has two interrupt lines,
              dedicated to both RX and TX interrupts so called "uart-rx"
	      and "uart-tx". UART0 has a third interrupt line which is
	      an OR of both RX and TX interrupts, so called "uart-sum".
	      The driver currently uses "uart-rx" and "uart-tx" for both
	      ports whereas older versions used only the summed
	      interrupt (when only UART0 was supported). UART0 uses
	      level interrupts while UART1 uses front interrupts.

Example:
	uart0: serial@12000 {
		compatible = "marvell,armada-3700-uart";
		reg = <0x12000 0x200>;
		clocks = <&xtalclk>;
		interrupts =
		<GIC_SPI 11 IRQ_TYPE_LEVEL_HIGH>,
		<GIC_SPI 12 IRQ_TYPE_LEVEL_HIGH>,
		<GIC_SPI 13 IRQ_TYPE_LEVEL_HIGH>;
		interrupt-names = "uart-sum", "uart-tx", "uart-rx";
		status = "disabled";
	};

	uart1: serial@12200 {
		compatible = "marvell,armada-3700-uart-ext";
		reg = <0x12200 0x30>;
		clocks = <&xtalclk>;
		interrupts =
		<GIC_SPI 30 IRQ_TYPE_EDGE_RISING>,
		<GIC_SPI 31 IRQ_TYPE_EDGE_RISING>;
		interrupt-names = "uart-tx", "uart-rx";
		status = "disabled";
	};
```

## Documentation/devicetree/bindings/thermal/armada-thermal.txt
```
* Marvell Armada 370/375/380/XP thermal management

Required properties:

- compatible: Should be set to one of the following:
    * marvell,armada370-thermal
    * marvell,armada375-thermal
    * marvell,armada380-thermal
    * marvell,armadaxp-thermal
    * marvell,armada-ap806-thermal
    * marvell,armada-cp110-thermal

- reg: Device's register space.
  Two entries are expected, see the examples below. The first one points
  to the status register (4B). The second one points to the control
  registers (8B).
  Note: The compatibles marvell,armada370-thermal,
  marvell,armada380-thermal, and marvell,armadaxp-thermal must point to
  "control MSB/control 1", with size of 4 (deprecated binding), or point
  to "control LSB/control 0" with size of 8 (current binding). All other
  compatibles must point to "control LSB/control 0" with size of 8.

Optionnal properties:

- interrupts: Should contain interrupt for thermal system
or
- interrupts-extended: Should contain parent node and interrupt for
                       thermal system (relevant for devices with irq-chip).
- threshold: Temperature threshold in Celsius, the threshold +/- calculated
             hysteresis (formula below) define the upper and lower watermark
             which when crossing, an interrupt will be asserted.
- hysteresis: Valid values are 0..3, following is upper/lower watermark
              calculation:
              high/low watermark = threshold +/- 0.4761 * 2^(hysteresis + 2).
              Following are the corresponding degrees corresponding to
              hysteresis value: 0=>1.9, 1=>3.8,  2=>7.6, 3=>15.2

Examples:

	/* Legacy bindings */
	thermal@d0018300 {
		compatible = "marvell,armada370-thermal";
		reg = <0xd0018300 0x4
		       0xd0018304 0x4>;
		interrupts = <GIC_SPI 78 IRQ_TYPE_LEVEL_HIGH>;
		threshold = <100>;
		hysteresis = <2>;
	};

	ap_thermal: thermal@6f8084 {
		compatible = "marvell,armada-ap806-thermal";
		reg = <0x6f808C 0x4>,
		      <0x6f8084 0x8>;
		interrupts-extended = <&sei 37>;
		threshold = <100>;
		hysteresis = <2>;
	};
```
